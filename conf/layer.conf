## conf/layer.conf
```bitbake
# We have a conf and classes directory, add to BBPATH
BBPATH := "${BBPATH}:${LAYERDIR}"

# We have a packages directory, add to BBFILES
BBFILES := "\
    ${BBFILES} \
    ${LAYERDIR}/recipes-*/*/*.bb \
    ${LAYERDIR}/*/recipes-*/*/*.bbappend \
"

BBFILE_COLLECTIONS += "prefixdistro"
BBFILE_PATTERN_prefixdistro := "^${LAYERDIR}/"
BBFILE_PRIORITY_prefixdistro = "10"
```
